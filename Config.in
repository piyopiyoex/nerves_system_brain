## package/lns/Config.in
```kconfig
config BR2_PACKAGE_LNS
	bool "lns"
	help
	  configfs にシンボリックリンクを作成するための小さな補助プログラムです。
	  BusyBox の ln を含まない現在の rootfs で使用します。
```

## toolchain/defconfig
```kconfig
BR2_arm=y
BR2_arm926t=y
BR2_TOOLCHAIN_EXTERNAL=y
BR2_TOOLCHAIN_EXTERNAL_BOOTLIN=y
BR2_TOOLCHAIN_EXTERNAL_BOOTLIN_ARMV5_EABI_GLIBC_STABLE=y
```
